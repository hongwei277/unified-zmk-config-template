#include <zephyr/dt-bindings/gpio/gpio.h>

/ {
    chosen {
        zmk,kscan = &kscan0;
    };

    kscan0: kscan {
        compatible = "zmk,kscan-gpio-direct";
        input-gpios =
            <&gpio0 17 GPIO_ACTIVE_LOW GPIO_PULL_UP>,  // A
            <&gpio0 20 GPIO_ACTIVE_LOW GPIO_PULL_UP>,  // B
            <&gpio0 22 GPIO_ACTIVE_LOW GPIO_PULL_UP>,  // Select
            <&gpio0 24 GPIO_ACTIVE_LOW GPIO_PULL_UP>,  // Start
            <&gpio1 0  GPIO_ACTIVE_LOW GPIO_PULL_UP>,  // Up
            <&gpio0 11 GPIO_ACTIVE_LOW GPIO_PULL_UP>,  // Down
            <&gpio1 4  GPIO_ACTIVE_LOW GPIO_PULL_UP>,  // Left
            <&gpio1 6  GPIO_ACTIVE_LOW GPIO_PULL_UP>;  // Right
    };
};
