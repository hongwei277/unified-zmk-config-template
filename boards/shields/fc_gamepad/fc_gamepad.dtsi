#include <zephyr/dt-bindings/gpio/gpio.h>

/ {
    chosen {
        zmk,kscan = &kscan0;
    };

    kscan0: kscan {
        compatible = "zmk,kscan-gpio-direct";
        input-gpios =
            <&pro_micro 2 GPIO_ACTIVE_LOW GPIO_PULL_UP>,  // A   D2 P0.17
            <&pro_micro 3 GPIO_ACTIVE_LOW GPIO_PULL_UP>,  // B   D3 P0.20
            <&pro_micro 4 GPIO_ACTIVE_LOW GPIO_PULL_UP>,  // Sel D4 P0.22
            <&pro_micro 5 GPIO_ACTIVE_LOW GPIO_PULL_UP>,  // Sta D5 P0.24
            <&pro_micro 6 GPIO_ACTIVE_LOW GPIO_PULL_UP>,  // Up  D6 P1.00
            <&pro_micro 7 GPIO_ACTIVE_LOW GPIO_PULL_UP>,  // Dn  D7 P0.11
            <&pro_micro 8 GPIO_ACTIVE_LOW GPIO_PULL_UP>,  // Lf  D8 P1.04
            <&pro_micro 9 GPIO_ACTIVE_LOW GPIO_PULL_UP>;  // Rt  D9 P1.06
    };
};
